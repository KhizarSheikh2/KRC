#ifndef OLED_DISPLAY_H
#define OLED_DISPLAY_H

#include <SPI.h>
#include <Wire.h>
#include <Adafruit_GFX.h>
#include <Adafruit_SH110X.h>
#include <Fonts/FreeSans12pt7b.h>      // Example font
#include <Fonts/FreeMonoBold9pt7b.h>   // Example font
#include <Fonts/FreeMonoBold12pt7b.h>  // Example font
#include <Fonts/FreeSerifBold9pt7b.h>  // Example font
#include <Fonts/FreeSerifItalic12pt7b.h> // Example font
#include <Fonts/Org_01.h>              // Example font

#define OLED_Address 0x3c  // I2C address for SH1106
#define SCREEN_WIDTH 128
#define SCREEN_HEIGHT 64
#define OLED_RESET -1
Adafruit_SH1106G display = Adafruit_SH1106G(SCREEN_WIDTH, SCREEN_HEIGHT, &Wire, OLED_RESET);

enum Mode {
  Temp_sc,
  // Tempsp_sc,
  Season_sc,
  CFM_sc,
  NUM_MODES
};

// Extern declarations for globals (define these in your main sketch)
// extern int current_mode;
// extern float temperature;  // From DS18B20
// extern float Setpoint;     // User-set value
// extern bool season;        // false = Summer, true = Winter
// extern int CFM;            // 0-9 (10% to 100% in 10% steps)

// Timer for setpoint display
// extern unsigned long setpointStartTime;
// extern const unsigned long setpointDuration;  // 5000 ms

int current_mode = Temp_sc;

// Bitmaps
const unsigned char BITA_LOGO[] PROGMEM = {
  0x7f, 0xff, 0xff, 0xfe, 0x60, 0x00, 0x00, 0x06, 0x40, 0x00, 0x00, 0x02, 0x40, 0x01, 0x80, 0x02,
  0x40, 0x03, 0x80, 0x02, 0x40, 0x03, 0xc0, 0x02, 0x40, 0x1f, 0xf8, 0x02, 0x40, 0x1f, 0xf8, 0x02,
  0x40, 0x1f, 0xf8, 0x02, 0x40, 0x1f, 0xf8, 0x02, 0x40, 0xcf, 0xf3, 0x02, 0x4f, 0xef, 0xf7, 0xf2,
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  0x40, 0x01, 0x80, 0x02, 0x40, 0x00, 0x00, 0x02, 0x60, 0x00, 0x00, 0x06, 0x7f, 0xff, 0xff, 0xfe
};

const unsigned char myBitmap_2[] PROGMEM = {
  // '23, 64x64px (full array)
  0xff, 0xff, 0xff, 0xff, 0xff, 0xff, 0xff, 0xff, 0xff, 0xff, 0xff, 0xff, 0xff, 0xff, 0xff, 0xff,
  0xff, 0xff, 0xff, 0xff, 0xff, 0xff, 0xff, 0xff, 0xff, 0xff, 0xff, 0xff, 0xff, 0xff, 0xff, 0xff,
  0xff, 0xff, 0xff, 0xff, 0xff, 0xff, 0xff, 0xff, 0xff, 0xff, 0xff, 0xff, 0xff, 0xff, 0xff, 0xff,
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  0xff, 0xff, 0xff, 0xe1, 0xf1, 0xff, 0xff, 0xf7, 0xff, 0xff, 0xff, 0xe1, 0xc1, 0xff, 0xff, 0xf7
};  // Picture

void showCenteredText(String text, uint8_t textSize = 2, int yOffset = 0) {
  display.clearDisplay();
  display.setTextSize(textSize);
  display.setFont();
  display.setTextColor(SH110X_WHITE);

  int16_t x1, y1;
  uint16_t w, h;
  display.getTextBounds(text.c_str(), 0, 0, &x1, &y1, &w, &h);  // Use c_str() for bounds
  int x = (SCREEN_WIDTH - w) / 2;
  int y = (SCREEN_HEIGHT - h) / 2 + yOffset;

  display.setCursor(x, y);
  display.print(text);  // Print String directly
  display.display();
}

void showStartupScreen() {
  display.clearDisplay();

  // Draw BITA logo centered (32x32 bitmap)
  int logoX = (SCREEN_WIDTH - 32) / 2;  // Center horizontally
  int logoY = (SCREEN_HEIGHT - 32) / 2; // Center vertically
  display.drawBitmap(logoX, logoY, BITA_LOGO, 32, 32, SH110X_WHITE);

  display.display();
  delay(1500);  // Show for 1.5 seconds
  display.clearDisplay();
}

void updateDisplay() {
  display.clearDisplay();
  display.setTextColor(SH110X_WHITE);

  // ===== HEADER =====
  String modeName;
  switch (current_mode) {
    case Temp_sc:   modeName = "TEMP"; break;
    case Season_sc: modeName = "SEASON";      break;
    case CFM_sc:    modeName = "CFM";         break;
  }

  // If setpoint was recently adjusted, override header to show SETPOINT
  if (setpoint_flag && millis() - setpointStartTime < setpointDuration) {
    modeName = "SETPOINT";
  }

  display.setTextSize(2);  // smaller size so long words fit
  int16_t x1, y1;
  uint16_t w, h;
  display.getTextBounds(modeName.c_str(), 0, 0, &x1, &y1, &w, &h);
  int x = (SCREEN_WIDTH - w) / 2;
  display.setCursor(x, 4);
  display.print(modeName);
  display.drawFastHLine(2, 20, SCREEN_WIDTH - 4, SH110X_WHITE);
  
  // ===== MAIN CONTENT =====
  String mainValue;

  if (current_mode == Temp_sc) {
    // Show setpoint value briefly when keys 3/4 pressed, else show temperature
    if (setpoint_flag && millis() - setpointStartTime < setpointDuration) {
      mainValue = String((float)setpointt, 1) + " " + (char)247 + "C";
    } else {
      setpoint_flag = false;  // timer expired, revert to temp
      if (temperature < -100) {
        mainValue = "Error";
      } else {
        mainValue = String(temperature, 1) + " " + (char)247 + "C";
      }
    }
  }else if (current_mode == Season_sc) {
    // mainValue = (seasonsw == 0) ? "SUMMER" : "WINTER";
    mainValue = seasonsw ? "WINTER" : "SUMMER";
  }else if (current_mode == CFM_sc) {
    mainValue = String(end_value) + "%";   // always shows true %, e.g. "60%"
  }

  display.setTextSize(3);
  display.getTextBounds(mainValue.c_str(), 0, 0, &x1, &y1, &w, &h);
  int tempX = (SCREEN_WIDTH - w) / 2;
  int tempY = (SCREEN_HEIGHT - h) / 2 + 12;
  display.setCursor(tempX, tempY);
  display.print(mainValue);
  display.display();
}

#endif  // OLED_DISPLAY_H